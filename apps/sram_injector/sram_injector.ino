#define DEBUG_CHECKS true
#define DEBUG_READ false
#define DEBUG_READ_PRINT false
#define DEBUG_WRITE false
#define DEBUG_WRITE_PRINT false

#define LOAD_BASE_ADDR   0x0000      
#define SERIAL_TIMEOUT   5000        

const int ADDR_PINS[15] = {
  23, 25, 27, 29, 31, 33, 35, 37,
  39, 41, 43, 45, 47, 49, 51
};

const int DATA_PINS[8] = {
  22, 24, 26, 28, 30, 32, 34, 36
};

const int WE_PIN = 2;
const int OE_PIN = 3;
const int CS_PIN = 4;
const int RESET_PIN = 5;
const int BE_PIN = 6;
const int SEND_PIN = 7;

uint8_t program[][16] =
{
    0xea, 0xea, 0xea, 0xea, 0xea, 0xea, 0xea, 0xea, 0xea, 0xea, 0xea, 0xea, 0xea, 0xea, 0xea, 0xea,
    0xea, 0xea, 0xea, 0xea, 0xea, 0xea, 0xea, 0xea, 0xea, 0xea, 0xea, 0xea, 0xea, 0xea, 0xea, 0xea,
    0xea, 0xea, 0xea, 0xea, 0xea, 0xea, 0xea, 0xea, 0xea, 0xea, 0xea, 0xea, 0xea, 0xea, 0xea, 0xea,
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    0xea, 0xea, 0xea, 0xea, 0xea, 0xea, 0xea, 0xea, 0xea, 0xea, 0xea, 0xea, 0xea, 0xea, 0xea, 0xea,
};
enum Mode {WRITE, READ};

void setup() {
    Serial.begin (57600);
    Serial.print ("\n\nProgram initialization...");
    deactivate_6502 ();
    init_pins ();
    Serial.println ("complete. Press to confirm booting the program");
    while (digitalRead (SEND_PIN) == 0);
    while (digitalRead (SEND_PIN) == 1);
    //while (digitalRead (SEND_PIN) == 0);
    
    Serial.println ("READY TO SEND IT, U SURE?");
    while (digitalRead (SEND_PIN) == 0);
    while (digitalRead (SEND_PIN) == 1);
    while (digitalRead (SEND_PIN) == 0);
    inject_program();
    Serial.println ("SENT");
    end_pins ();
    activate_6502 ();
    Serial.println ("done.");
    
}

void deactivate_6502 ()
{
    pinMode (BE_PIN, OUTPUT);
    digitalWrite (BE_PIN, LOW);
    pinMode (RESET_PIN, OUTPUT);
    digitalWrite (RESET_PIN, LOW);
    delayMicroseconds (10);
}

void activate_6502 ()
{
    digitalWrite(BE_PIN, HIGH);
    delayMicroseconds(2);       
    digitalWrite(RESET_PIN, HIGH); 
}

void loop() { }

void end_pins ()
{
    //digitalWrite (CS_PIN, HIGH);
    //pinMode (CS_PIN, INPUT);
    //pinMode (OE_PIN, INPUT);
    //pinMode (WE_PIN, INPUT);
    pinMode (CS_PIN, INPUT);
    digitalWrite (OE_PIN, LOW);
    digitalWrite (WE_PIN, HIGH);

    for (int i = 0; i < 15; i++)
        pinMode(ADDR_PINS[i], INPUT);
    for (int i = 0; i < 8; i++)
        pinMode(DATA_PINS[i], INPUT);
}

void init_pins ()
{ 
    pinMode (SEND_PIN, INPUT);

    for (int i = 0; i < 15; i++)
      pinMode (ADDR_PINS[i], OUTPUT);
    for (int i = 0; i < 8; i++)
      pinMode (DATA_PINS[i], INPUT);
    

    // ram not selected (cs active low)
    pinMode (CS_PIN, OUTPUT);
    digitalWrite(CS_PIN, HIGH);
    pinMode (WE_PIN, OUTPUT);
    digitalWrite(WE_PIN, HIGH);
    pinMode (OE_PIN, OUTPUT);
    digitalWrite(OE_PIN, HIGH);
}


void _debug_print (unsigned int address, uint8_t data, Mode mode)
{ 
    if (mode == WRITE)
      Serial.print ("w");
    else if (mode == READ)
      Serial.print ("r");
    Serial.print (" | ADDR: ");
    Serial.print (address, HEX);
    Serial.print (" ( ");
    Serial.print (address, BIN);
    Serial.print (" ) DATA -> <");
    Serial.print (data, HEX);
    Serial.print ("> ( ");
    Serial.print (data, BIN);
    Serial.println (");");
}

void data_write (unsigned int address, uint8_t data)
{
    // to assure high impedance
    for (int i = 0; i < 8; i++)
        pinMode (DATA_PINS[i], INPUT);
    
    for (int i = 0; i < 15; i++)
        digitalWrite(ADDR_PINS[i], (address >> i) & 0x1);
    delayMicroseconds (1);
    
    digitalWrite(OE_PIN, HIGH);  
    delayMicroseconds (1);

    digitalWrite(CS_PIN, LOW);
    delayMicroseconds (1);

    delayMicroseconds(1);        
    
    digitalWrite(WE_PIN, LOW);   
    delayMicroseconds(1);        

    for (int i = 0; i < 8; i++)
    {
        pinMode (DATA_PINS[i], OUTPUT);
        digitalWrite (DATA_PINS[i], (data >> i) & 0x1);
    }
    delayMicroseconds (1);

    digitalWrite (WE_PIN, HIGH);
    delayMicroseconds (1);

    digitalWrite(CS_PIN, HIGH);
    delayMicroseconds (1);

    // for safety
    for (int i = 0; i < 8; i++)
        pinMode(DATA_PINS[i], INPUT);
    delayMicroseconds (1);

    if (DEBUG_WRITE || DEBUG_WRITE_PRINT)
        _debug_print (address, data, WRITE);
}

uint8_t data_read (unsigned int address)
{
    uint8_t data = 0x0;
    
    for (int i = 0; i < 8; i++)
      pinMode (DATA_PINS[i], INPUT);
    delayMicroseconds (1);

    for (int i = 0; i < 15; i++)  
      digitalWrite (ADDR_PINS[i], (address >> i) & 0x1);

    digitalWrite (CS_PIN, LOW);
    delayMicroseconds (1);

    digitalWrite (OE_PIN, LOW);
    delayMicroseconds (1);

    for (int i = 0; i < 8; i++)
      data |= (digitalRead (DATA_PINS[i]) << i);

    digitalWrite (CS_PIN, HIGH);
    delayMicroseconds (1);
    
    digitalWrite (OE_PIN, HIGH);
    delayMicroseconds (1);

    if (DEBUG_READ | DEBUG_READ_PRINT)
        _debug_print (address, data, READ);

    return data;
}

void inject_program ()
{ 
    Serial.print ("Injecting program...");
    uint16_t addr = 0;
    int i, j;
    for (i = 0; i < 100; i++)
      for (j = 0; j < 16; j++)
        data_write (addr++, program[i][j]);

    data_write (0x7ffc, 0x00);
    data_write (0x7ffd, 0x80);
    Serial.print ("complete...integrity check...");

    for (addr = i = j = 0; addr < 0xA0; addr++, i++)
    {   
        if (i == 0x10)
        {
          i = 0; 
          j++;
        } 
        if (program[j][i] != data_read (addr))
        {
          Serial.println ("ERROR");
          Serial.println (program[j][i], HEX);
          return ;
        } 
    }

    Serial.println ("success");
} 